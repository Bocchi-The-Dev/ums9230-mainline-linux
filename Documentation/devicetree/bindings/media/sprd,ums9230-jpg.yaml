## Documentation/devicetree/bindings/media/sprd,ums9230-jpg.yaml
```yaml
# SPDX-License-Identifier: (GPL-2.0 OR BSD-2-Clause)
%YAML 1.2
---
$id: http://devicetree.org/schemas/media/sprd,ums9230-jpg.yaml#
$schema: http://devicetree.org/meta-schemas/core.yaml#

title: Unisoc UMS9230 JPEG codec

maintainers:
  - Seuj09 <jeus110310@gmail.com>

description:
  The JPEG codec block of the Unisoc UMS9230 and related SoCs. It is part of
  the multimedia subsystem and shares its power domain.

properties:
  compatible:
    const: sprd,ums9230-jpg

  reg:
    maxItems: 1

  interrupts:
    maxItems: 1

  clocks:
    items:
      - description: Multimedia clock generator gate
      - description: Clock gate of the codec
      - description: Codec clock (mux of the 76.8, 128, 256 and 384 MHz TWPLL outputs)

  resets:
    items:
      - description: Soft reset of the codec

  power-domains:
    maxItems: 1

required:
  - compatible
  - reg
  - interrupts
  - clocks
  - resets
  - power-domains

additionalProperties: false

examples:
  - |
    #include <dt-bindings/interrupt-controller/arm-gic.h>
    #include <dt-bindings/clock/sprd,ums9230-clk.h>
    #include <dt-bindings/reset/sprd,ums9230-reset.h>
    #include <dt-bindings/power/sprd,ums9230-power.h>

    jpeg-codec@36000000 {
        compatible = "sprd,ums9230-jpg";
        reg = <0x36000000 0xc000>;
        interrupts = <GIC_SPI 42 IRQ_TYPE_LEVEL_HIGH>;
        clocks = <&mm_gate CLK_MM_CKG_EB>, <&mm_gate CLK_MM_JPG_EB>,
                 <&mm_clk CLK_JPG>;
        resets = <&mm_gate RESET_MM_AHB_JPG_SOFT_RST_MASK>;
        power-domains = <&pmu UMS9230_POWER_DOMAIN_MM>;
    };
```

## Documentation/devicetree/bindings/media/sprd,ums9230-vsp.yaml
```yaml
# SPDX-License-Identifier: (GPL-2.0 OR BSD-2-Clause)
%YAML 1.2
---
$id: http://devicetree.org/schemas/media/sprd,ums9230-vsp.yaml#
$schema: http://devicetree.org/meta-schemas/core.yaml#

title: Unisoc UMS9230 video codec (VSP)

maintainers:
  - Seuj09 <jeus110310@gmail.com>

description:
  The video codec block (VSP) of the Unisoc UMS9230 and related SoCs. It sits
  in its own power domain behind the multimedia subsystem, is clocked from a
  gate and a mux that selects one of three TWPLL outputs, and is reset by two
  bits in the AP AHB register block.

properties:
  compatible:
    const: sprd,ums9230-vsp

  reg:
    maxItems: 1

  interrupts:
    maxItems: 1

  clocks:
    items:
      - description: Clock gate of the codec
      - description: Codec clock (mux of the 256, 307.2 and 384 MHz TWPLL outputs)

  clock-names:
    items:
      - const: enable
      - const: codec

  resets:
    items:
      - description: Global soft reset of the VSP
      - description: Soft reset of the codec core

  reset-names:
    items:
      - const: global
      - const: core

  power-domains:
    items:
      - description: Multimedia subsystem domain
      - description: VSP domain

  power-domain-names:
    items:
      - const: mm
      - const: vsp

  iommus:
    maxItems: 1

required:
  - compatible
  - reg
  - interrupts
  - clocks
  - clock-names
  - resets
  - reset-names
  - power-domains
  - power-domain-names

additionalProperties: false

examples:
  - |
    #include <dt-bindings/interrupt-controller/arm-gic.h>
    #include <dt-bindings/clock/sprd,ums9230-clk.h>
    #include <dt-bindings/reset/sprd,ums9230-reset.h>
    #include <dt-bindings/power/sprd,ums9230-power.h>

    video-codec@32000000 {
        compatible = "sprd,ums9230-vsp";
        reg = <0x32000000 0xc000>;
        interrupts = <GIC_SPI 34 IRQ_TYPE_LEVEL_HIGH>;
        clocks = <&apahb_gate CLK_VSP_EB>, <&ap_clk CLK_VSP>;
        clock-names = "enable", "codec";
        resets = <&apahb_gate RESET_AP_AHB_VSP_GLOBAL_SOFT_RST>,
                 <&apahb_gate RESET_AP_AHB_VSP_SOFT_RST>;
        reset-names = "global", "core";
        power-domains = <&pmu UMS9230_POWER_DOMAIN_MM>,
                        <&pmu UMS9230_POWER_DOMAIN_AP_VSP>;
        power-domain-names = "mm", "vsp";
        iommus = <&iommu_vsp>;
    };
```

## drivers/media/platform/sprd/vsp/Kconfig
```kconfig
# SPDX-License-Identifier: GPL-2.0-only

config VIDEO_SPRD_VSP
	tristate "Unisoc VSP video and JPEG codec driver"
	depends on ARCH_SPRD || COMPILE_TEST
	depends on PM
	depends on DEBUG_FS
	depends on VIDEO_DEV
	depends on MEDIA_CONTROLLER
	select PM_GENERIC_DOMAINS
	select V4L2_MEM2MEM_DEV
	select VIDEOBUF2_DMA_CONTIG
	help
	  Powers up the video codec (VSP) and JPEG codec blocks of the Unisoc UMS9230
	  and exposes a register dump in debugfs. On the VSP it also registers an
	  EXPERIMENTAL stateless H.264 decoder (intra slices only for now) written
	  from a reverse-engineered register map; it has not been verified on hardware.

	  To compile this driver as a module, choose M here: the module
	  will be called sprd-vsp.
```
